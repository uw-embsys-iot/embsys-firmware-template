## tests/lib/custom_lib/testcase.yaml
```yaml
common:
  tags: extensibility
  integration_platforms:
    # Need to run the test on a platform that runs on a CI machine.
    - qemu_cortex_m0
tests:
  lib.custom_lib: {}
  lib.custom_lib.non_default:
    extra_args: CONFIG_CUSTOM_LIB_GET_VALUE_DEFAULT=6
```
